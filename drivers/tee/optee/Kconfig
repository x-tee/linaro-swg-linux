## drivers/tee/optee/Kconfig
```kconfig
# SPDX-License-Identifier: GPL-2.0-only
# OP-TEE Trusted Execution Environment Configuration
config OPTEE
	tristate "OP-TEE"
	depends on HAVE_ARM_SMCCC
	depends on MMU
	depends on RPMB || !RPMB
	help
	  This implements the OP-TEE Trusted Execution Environment (TEE)
	  driver.

config OPTEE_INSECURE_LOAD_IMAGE
	bool "Load OP-TEE image as firmware"
	default n
	depends on OPTEE && ARM64
	help
	  This loads the BL32 image for OP-TEE as firmware when the driver is
	  probed. This returns -EPROBE_DEFER until the firmware is loadable from
	  the filesystem which is determined by checking the system_state until
	  it is in SYSTEM_RUNNING. This also requires enabling the corresponding
	  option in Trusted Firmware for Arm. The documentation there explains
	  the security threat associated with enabling this as well as
	  mitigations at the firmware and platform level.
	  https://trustedfirmware-a.readthedocs.io/en/latest/threat_model/threat_model.html

	  Additional documentation on kernel security risks are at
	  Documentation/tee/op-tee.rst.

config OPTEE_STATIC_PROTMEM_POOL
	bool
	depends on HAS_IOMEM && TEE_DMABUF_HEAPS
	default y

config OPTEE_TEELOG
	bool "OP-TEE TEE log export (resident ledger + lifecycle)"
	depends on TEE = y
	help
	  Build the resident teelog page-allocation ledger into the TEE
	  framework core (tee.o) and, when CONFIG_OPTEE is enabled, the
	  OP-TEE driver lifecycle that allocates REE pages, REGISTER /
	  UNREGISTER via the REE_KERNEL PTA, and recovers isolated slots
	  on later probe. The ledger survives optee.ko unload so a later
	  probe can safely reclaim log pages. Selecting this does not
	  require CONFIG_OPTEE=y; OP-TEE may still be built as a module.
	  The ledger is a single slot: only one log allocation at a time.
	  A read-only /sys/kernel/teelog_ledger file (0444) reports
	  occupancy, generation, size, order, next_gen and the cumulative
	  recorded_pages/freed_pages counters (both use 1<<order: record()
	  and free_pages() respectively) so a later probe or
	  userspace test can inspect the slot after optee.ko unload. It
	  does not expose PA (design: PA stays in-kernel) and is not a
	  release or generation-reset API.

config OPTEE_TEELOG_FAULT_INJECT
	bool "OP-TEE teelog PTA fault injection (test builds)"
	depends on OPTEE_TEELOG && OPTEE
	default n
	help
	  Expose module parameter optee.inject on the OP-TEE driver for
	  controlled REGISTER/UNREGISTER result injection. Independent of
	  whether teelog KUnit is built-in (y) or modular (m). REJECTED is
	  applied before the real invoke; post-call inject may only force
	  UNKNOWN. Also creates root-only /sys/kernel/teelog_ledger_pa
	  (0400) so isolate tests can compare PA across rmmod without
	  putting PA on the production 0444 occupancy file. Leave
	  disabled for production images.

config OPTEE_TEELOG_KUNIT_TEST
	tristate "KUnit tests for teelog lifecycle state machine" if !KUNIT_ALL_TESTS
	depends on OPTEE_TEELOG && OPTEE && KUNIT
	# Built-in tests need built-in optee (exported ring_read symbols).
	depends on OPTEE=y || m
	default KUNIT_ALL_TESTS
	help
	  Unit tests for teelog invoke classification, recovery decisions,
	  page-fate mapping, inject policy helpers, and ring-reader catch-up.
	  Links against symbols exported from the OP-TEE teelog objects; do
	  not duplicate teelog_ring_read.o into this test module. Does not
	  require a live TEE and does not by itself enable runtime fault
	  injection (see OPTEE_TEELOG_FAULT_INJECT). Decision-helper coverage
	  is not a substitute for end-to-end fault-path resource accounting.
```
